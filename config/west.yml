## config/west.yml
```yaml
manifest:
  remotes:
    - name: zmkfirmware
      url-base: https://github.com/zmkfirmware
    - name: dhruvinsh
      url-base: https://github.com/dhruvinsh
  projects:
    - name: zmk
      remote: zmkfirmware
      revision: 241ff39556b3685c9344c4c22fd9a655af8eb3ba # 0.2.1
      import: app/west.yml
    - name: zmk-tri-state
      remote: dhruvinsh
      revision: ebbc1f0ccdb51669650bb0ac3e34920d09e62400
  self:
    path: config
```

## west.yml
```yaml
manifest:
  remotes:
    - name: zmkfirmware
      url-base: https://github.com/zmkfirmware
    - name: pipex
      url-base: https://github.com/pipex
  projects:
    - name: zmk
      remote: pipex
      revision: main
      import: app/west.yml
  self:
    path: config
```
